#ifndef __MAIN_HPP__
#define __MAIN_HPP__    

#include <Arduino.h>
#include <TFT_eSPI.h>

extern TFT_eSPI tft;

typedef struct {
    uint8_t cmd;        // 命令
    uint8_t data[14];   // 数据（最多 14 个）
    uint8_t len;        // 数据长度 (bit7=1 表示需要延时 120ms)
} lcd_cmd_t;

lcd_cmd_t lcd_gc9306[] = {
    {0xFE, {0}, 0},
    {0xEF, {0}, 0},

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    {0xA9, {0x2A, 0x2A}, 2},

    // 窗口设置 240x320
    {0x2A, {0x00, 0x00, 0x00, 0xEF}, 4},
    {0x2B, {0x00, 0x00, 0x01, 0x3F}, 4},

    {0x35, {0x00}, 1},
    {0x44, {0x00, 0x0A}, 2},

    // Gamma 设置
    {0xF0, {0x02,0x00,0x00,0x25,0x26,0x05}, 6},
    {0xF1, {0x01,0x03,0x00,0x33,0x33,0x0A}, 6},
    {0xF2, {0x05,0x03,0x3C,0x04,0x04,0x4C}, 6},
    {0xF3, {0x09,0x04,0x47,0x03,0x02,0x52}, 6},
    {0xF4, {0x0A,0x17,0x16,0x1F,0x21,0x0F}, 6},
    {0xF5, {0x07,0x12,0x12,0x1F,0x20,0x0F}, 6},

    // 休眠退出 + 延时
    {0x11, {0}, 0 | 0x80},  // Sleep Out
    {0x29, {0}, 0 | 0x80},  // Display On
    {0x2C, {0}, 0},         // Memory Write
};


void Init_GC9306() {

    tft.begin();
    pinMode(TFT_RST, OUTPUT);
    digitalWrite(TFT_RST, HIGH);
    delay(120);
    digitalWrite(TFT_RST, LOW);
    delay(100);
    digitalWrite(TFT_RST, HIGH);
    delay(120);

    for (uint8_t i = 0; i < (sizeof(lcd_gc9306) / sizeof(lcd_cmd_t)); i++) {
        tft.writecommand(lcd_gc9306[i].cmd);
        for (int j = 0; j < (lcd_gc9306[i].len & 0x7F); j++) {
            tft.writedata(lcd_gc9306[i].data[j]);
        }

        if (lcd_gc9306[i].len & 0x80) {
            delay(120);  // 带延时标志的命令延时
        }
    }
    delay(1000);
}




#endif
